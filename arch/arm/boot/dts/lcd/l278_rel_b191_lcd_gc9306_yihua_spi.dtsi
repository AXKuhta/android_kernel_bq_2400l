/ { lcds {
	lcd_gc9306_yihua: lcd419306@9306 {

		panel-name = "gc9306_41";
		status = <1>;
		if-type = <4>;
		spi_bus_num = <1>;
		spi_cs = <0>;
		bpp = <16>;
		fps = <33>;
		spi_mode = <3>; /* SPI_CPHA 0x01 SPI_CPOL 0x02 */
		spi_cd_gpio = <91>;
		spi_te_gpio = <51>;
		spi_pol_mode = <0>;
		spi_endian = <0>;
		spi_freq = <48000000>;
		hactive = <240>;
		vactive = <320>;

		power-on-sequence = <
					50  1  5
					50  0  5
					50  1  20
					>;
		power-off-sequence = <
					50  0  20
					>;
		
		init-data = [
                ff 00 00 01 fe
                ff 00 00 01 ef
                ff 00 00 02 36 48
                ff 00 00 02 3a 05
                ff 00 00 02 35 00
                ff 00 00 03 a4 44 44
                ff 00 00 03 a5 42 42
                ff 00 00 03 aa 88 88
                ff 00 00 03 e8 12 40
                ff 00 00 03 e3 01 10
                ff 00 00 02 ff 61
                ff 00 00 02 AC 00
                ff 00 00 02 Ad 33
                ff 00 00 02 ae 2b
                ff 00 00 02 Af 55
                ff 00 00 03 a6 2a 2a
                ff 00 00 03 a7 2B 2B
                ff 00 00 03 a8 1f 1f
                ff 00 00 03 a9 2a 2a
                ff 00 00 05 2a 00 00 00 ef
                ff 00 00 05 2b 00 00 01 3f
                ff 00 00 01 2c
                ff 00 00 07 F0 02 02 00 01 04 09
                ff 00 00 07 F1 01 00 00 03 0d 12
                ff 00 00 07 F2 0a 06 31 03 03 46
                ff 00 00 07 F3 13 0d 40 05 05 4f
                ff 00 00 07 F4 08 12 12 1F 3a 0F
                ff 00 00 07 F5 08 10 10 1f 3a 0f
				ff 78 00 01 11
				ff 20 00 01 29
				ff 00 00 01 2c
		];
        sleep-in = [    
			ff 78 00 01 28
			ff 20 00 01 10
			];
		sleep-out = [
			ff 20 00 01 11
			ff 78 00 01 29
			];
		enable-te = [
			ff 00 00 02 35 00
			];
		disable-te = [
			ff 00 00 01 34
			];
	};
};};

