/ { lcds {
	lcd_gc9305_spi_qvga: lcd9305@9305 {

		panel-name = "gc9305";
		status = <0>;
		if-type = <4>;
		spi_bus_num = <1>;
		spi_cs = <0>;
		bpp = <16>;
		fps = <33>;
		spi_mode = <3>; /* SPI_CPHA 0x01 SPI_CPOL 0x02 */
		spi_cd_gpio = <91>;
		spi_te_gpio = <51>;
		spi_pol_mode = <0>;
		spi_endian = <0>;
		spi_freq = <48000000>;
		hactive = <240>;
		vactive = <320>;

		power-on-sequence = <
					50  1  5
					50  0  5
					50  1  20
					>;
		power-off-sequence = <
					50  0  20
					>;

		init-data = [
			ff 00 00 01 fe
			ff 00 00 01 ef
			ff 00 00 02 36 48
			ff 00 00 02 3a 05
			ff 00 00 02 35 00
			ff 00 00 03 a4 44 44
			ff 00 00 03 a5 42 42
			ff 00 00 03 aa 88 88
			ff 00 00 03 e8 21 72
			ff 00 00 03 e3 01 18
			ff 00 00 03 e1 10 0a
			ff 00 00 02 AC 00
			ff 00 00 02 ae 2b
			ff 00 00 02 ad 33
			ff 00 00 02 Af 55
			ff 00 00 03 a6 29 29
			ff 00 00 03 a7 27 27
			ff 00 00 03 a8 17 17
			ff 00 00 03 a9 26 26
			ff 00 00 05 2a 00 00 00 ef
			ff 00 00 05 2b 00 00 01 3f
			ff 00 00 07 f0 02 02 00 03 09 0c
			ff 00 00 07 f1 01 03 00 04 12 13
			ff 00 00 07 f2 0c 07 34 03 04 46
			ff 00 00 07 f3 14 0B 42 04 05 50
			ff 00 00 07 f4 09 13 13 1e 22 0F
			ff 00 00 07 f5 08 0e 0e 22 2b 0F
			ff 78 00 01 11
			ff 20 00 01 29
			ff 00 00 01 2c
			];
		sleep-in = [
			ff 78 00 01 28
			ff 20 00 01 10
			];
		sleep-out = [
			ff 20 00 01 11
			ff 78 00 01 29
			];
		enable-te = [
			ff 00 00 02 35 00
			];
		disable-te = [
			ff 00 00 01 34
			];
	};
};};

