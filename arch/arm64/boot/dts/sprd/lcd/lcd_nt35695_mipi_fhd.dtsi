/ { lcds {
	lcd_nt35695_mipi_fhd: lcd35695@35695 {

		work-mode = <1>;
		bpp = <24>;
		lane-number = <4>;

		need-check-esd = <0>;
		esd-timeout = <2000>;
		esd-check-reg = <0xA>;
		esd-return-code = <0x9c>;

		fps = <60>;
		width-mm = <68>;
		height-mm = <121>;
		panel-name = "truly_nt35695_mipi_fhd";

		power-on-sequence = <
					4  1  5
					5  1  5
					50  1  5
					50  0  5
					50  1  20
					>;
		power-off-sequence = <
					5  0  5
					4  0  5
					50  1  5
					>;

		init-data = [
			23 00 00 02 FF 20

			23 00 00 02 00 01
			23 00 00 02 01 55
			23 00 00 02 02 45
			23 00 00 02 03 55
			23 00 00 02 05 50
			23 00 00 02 06 4A
			23 00 00 02 07 24
			23 00 00 02 08 0C
			23 00 00 02 0B 87
			23 00 00 02 0C 87
			23 00 00 02 0E B0
			23 00 00 02 0F B3
			23 00 00 02 11 25
			/* 10 VCOM 171201  */
			23 00 00 02 12 10
			23 00 00 02 13 03
			23 00 00 02 14 4A
			23 00 00 02 15 12
			23 00 00 02 16 12
			23 00 00 02 30 01

			23 00 00 02 58 82
			23 00 00 02 59 00
			23 00 00 02 5A 02
			23 00 00 02 5B 00
			23 00 00 02 5C 82
			23 00 00 02 5D 82
			23 00 00 02 5E 02
			23 00 00 02 5F 02


			23 00 00 02 72 31
			23 00 00 02 FB 01


			/* CMD2_P4 */
			23 00 00 02 FF 24


			23 00 00 02 00 01
			23 00 00 02 01 0B
			23 00 00 02 02 0C
			23 00 00 02 03 09
			23 00 00 02 04 0A
			23 00 00 02 05 1C
			23 00 00 02 06 10
			23 00 00 02 07 00
			23 00 00 02 08 1C
			23 00 00 02 09 00
			23 00 00 02 0A 00
			23 00 00 02 0B 00
			23 00 00 02 0C 00
			23 00 00 02 0D 13
			23 00 00 02 0E 15
			23 00 00 02 0F 17
			23 00 00 02 10 01
			23 00 00 02 11 0B
			23 00 00 02 12 0C
			23 00 00 02 13 09
			23 00 00 02 14 0A
			23 00 00 02 15 1C
			23 00 00 02 16 10
			23 00 00 02 17 10
			23 00 00 02 18 1C
			23 00 00 02 19 00
			23 00 00 02 1A 00
			23 00 00 02 1B 00
			23 00 00 02 1C 00
			23 00 00 02 1D 13
			23 00 00 02 1E 15
			23 00 00 02 1F 17


			23 00 00 02 20 00
			23 00 00 02 21 03
			23 00 00 02 22 01
			23 00 00 02 23 4A
			23 00 00 02 24 4A
			23 00 00 02 25 6D
			23 00 00 02 26 40
			23 00 00 02 27 40

			23 00 00 02 BD 20
			23 00 00 02 B6 22
			23 00 00 02 B7 24
			23 00 00 02 B8 07
			23 00 00 02 B9 07
			23 00 00 02 C1 6D
			23 00 00 02 BE 07
			23 00 00 02 BF 07

			23 00 00 02 29 D8
			23 00 00 02 2A 2A

			23 00 00 02 4B 04
			23 00 00 02 4C 12
			23 00 00 02 4D 00
			23 00 00 02 4E 22
			23 00 00 02 4F 22
			23 00 00 02 50 00
			23 00 00 02 51 61
			23 00 00 02 52 01
			23 00 00 02 53 08
			23 00 00 02 56 08
			23 00 00 02 54 8A
			23 00 00 02 58 8A

			23 00 00 02 55 6D

			23 00 00 02 5B 43
			23 00 00 02 5C 00
			23 00 00 02 5F 73
			23 00 00 02 60 73
			23 00 00 02 63 22
			23 00 00 02 64 00
			23 00 00 02 67 08
			23 00 00 02 68 04

			23 00 00 02 7A 80
			23 00 00 02 7B 91
			23 00 00 02 7C D8
			23 00 00 02 7D 60
			23 00 00 02 75 20
			23 00 00 02 7F 20
			23 00 00 02 74 10
			23 00 00 02 7E 10

			23 00 00 02 93 06
			23 00 00 02 94 06

			23 00 00 02 B3 00
			23 00 00 02 B4 00
			23 00 00 02 B5 00

			23 00 00 02 78 00
			23 00 00 02 79 00
			23 00 00 02 80 00
			23 00 00 02 83 00
			23 00 00 02 84 04

			23 00 00 02 8A 33
			23 00 00 02 9B 0F
			23 00 00 02 8B F0

			/* BK_EN  */
			23 00 00 02 E3 00

			23 00 00 02 FB 01


			23 00 00 02 EC 00



			/* CMD1  */

			23 00 00 02 FF 10
			39 00 00 04 3B 03 24 20

			/* TE ON  */

			23 00 00 02 35 00

			23 00 00 02 BB 13

			/* CABC ON */
			39 00 00 03 51 FF 00
			23 00 00 02 53 2C
			23 00 00 02 55 00
			13 78 00 01 11
			13 0a 00 01 29

			];
		sleep-in = [
			13 01 00 01 00
			13 0A 00 01 28
			13 78 00 01 10
			23 0a 00 02 4F 01
			];
		sleep-out = [
			13 78 00 01 11
			13 32 00 01 29
			];

		display-timings {
			clock-frequency = <979800>;
			hactive = <1080>;
			vactive = <1920>;
			hback-porch = <16>;
			hfront-porch = <176>;
			vback-porch = <32>;
			vfront-porch = <32>;
			hsync-len = <10>;
			vsync-len = <4>;
		};
	};
};};
