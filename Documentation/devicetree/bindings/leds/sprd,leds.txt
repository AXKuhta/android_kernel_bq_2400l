## Documentation/devicetree/bindings/leds/sprd,leds.txt
```
Spreadtrum leds driver bindings

Required properties:
- compatible: must be one of
  sprd,sc2731-bltc-rgb"
  sprd,sc2731-kpled"

- reg: the chipselect index

Example:

bltc-rgb@200  {
	compatible = "sprd,sc2731-bltc-rgb";
	reg = <0x200>;
};

kpled@2c4 {
	compatible = "sprd,sc2731-kpled";
	reg = <0x2c4>;
};
```

## drivers/misc/sprd_camera/Kconfig
```kconfig
config SPRD_CAMERA
	tristate "Spreadtrum Camera Driver"
	depends on ARCH_SPRD && ION_SPRD
	help
	    This is a camera driver for Spreadtrum SOCs.

source "drivers/misc/sprd_camera/dcam/Kconfig"
source "drivers/misc/sprd_camera/isp/Kconfig"
source "drivers/misc/sprd_camera/cpp/Kconfig"
source "drivers/misc/sprd_camera/sensor/Kconfig"
source "drivers/misc/sprd_camera/common/Kconfig"
source "drivers/misc/sprd_camera/flash/Kconfig"

config SPRD_CAM_PIP_VIV
	bool "Spreadtrum Camera double dcam/isp Driver"
	depends on SPRD_CAMERA
	help
	    run two dcam and isp same time

config ISP_CPP_COWORK_SUPPORT
	bool "Spreadtrum Camera isp cpp cowork support"
	depends on SPRD_CAMERA
	help
	    use CPP and ISP together to support 4x
```

## drivers/misc/sprd_camera/common/Kconfig
```kconfig
config SPRD_CAM_PW_DOMAIN_R5P0
	bool "Spreadtrum Camera Power Domain R5P0"
	depends on SPRD_CAMERA
	help
	    This is a power domain driver for cam & dispc sys.
```

## drivers/misc/sprd_camera/cpp/Kconfig
```kconfig
config SPRD_CAMERA_CPP_LITE_R3P0
	bool "Spreadtrum Camera CPP LITE R3P0 Driver"
	depends on SPRD_CAMERA
	help
	    Support for CPP on Spreadtrum SOCs, it is used for image rotation
	    and scaling when using camera.
```

## drivers/misc/sprd_camera/dcam/Kconfig
```kconfig
config SPRD_CAMERA_MULTI_DCAM
    bool "Spreadtrum Camera Multi DCAM"
    depends on SPRD_CAMERA
    help
        This is a multi DCAM driver for Spreadtrum SOCs.

config SPRD_CAMERA_SINGLE_DCAM
    bool "Spreadtrum Camera Single DCAM"
    depends on SPRD_CAMERA
    help
        This is a single DCAM driver for Spreadtrum SOCs.

config SPRD_CAMERA_DCAM_IF_R4P0
    bool "Spreadtrum Camera DCAM IF R4P0"
    depends on SPRD_CAMERA
    help
        This is DCAM_IF_R4P0 driver for Spreadtrum SOCs
        and sharle, if you want to use this config,
        please to read spec and driver code,
        they can help you to use r4p0 driver
```

## drivers/misc/sprd_camera/isp/Kconfig
```kconfig
config SPRD_CAMERA_ISP_R6P11
    bool "Spreadtrum Camera ISP R6P11"
    depends on SPRD_CAMERA
    help
        This is ISP R6P11 driver for Spreadtrum SOCs.
```

## drivers/misc/sprdwcn_bsp/sc23xx/Kconfig
```kconfig
#
# Spreadtrum WCN device (NEW )configuration
#
menu "Spreadtrum WCN Device Drivers(for new chip...)"
config SC23XX
	tristate "SC23XX chip Support"
	#depends on MMC
	default n
	help
	  This is support wcn chip for spreadtrum.
	  if you want to use 23xx series wcn chip of spreadtrum.
	  please say "y".
	  Thanks.

config SC2355
	tristate "SC2355 chip Support"
	depends on SC23XX
	default n
	help
	  This is support wcn chip for spreadtrum.
	  If you want to use sc2355 chip of spreadtrum.
	  Please say "y".
	  Thanks.

config SC2366
	tristate "SC2366 chip Support"
	depends on SC23XX
	default n
	help
	  This is support wcn chip for spreadtrum.
	  If you want to use sc2366 chip of spreadtrum.
	  Please say "y".
	  Thanks.

# sprd's SDIO device driver based on SC2355...,etc
source "drivers/misc/sprdwcn_bsp/sc23xx/sdio/Kconfig"

endmenu
```
